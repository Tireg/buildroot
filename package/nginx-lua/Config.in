## package/nginx-lua/Config.in
```kconfig
config BR2_PACKAGE_NGINX_LUA
	bool "nginx-lua"
	select BR2_PACKAGE_LUAJIT
	select BR2_PACKAGE_NGX_DEVEL_KIT
	help
	  A module for nginx web server for handling lua syntax

	  https://github.com/openresty/lua-nginx-module
```

## package/ngx-devel-kit/Config.in
```kconfig
config BR2_PACKAGE_NGX_DEVEL_KIT
	bool "ngx-devel-kit"
	help
	  Nginx Development Kit

	  An Nginx module that adds additional generic tools that module developers
	  can use in their own modules

	  https://github.com/simplresty/ngx_devel_kit
```

## package/spl/Config.in
```kconfig
config BR2_PACKAGE_SPL
	bool "spl"
	depends on BR2_LINUX_KERNEL
	help
	  Solaris Porting Layer
	  A shim layer which adds the core interfaces required for OpenZFS.

	  https://github.com/zfsonlinux/spl
```

## package/zfs/Config.in
```kconfig
config BR2_PACKAGE_ZFS
	bool "zfs"
	depends on BR2_LINUX_KERNEL
	select BR2_PACKAGE_SPL
	select BR2_PACKAGE_ZLIB
	select BR2_PACKAGE_ZLIB_NG
	select BR2_PACKAGE_UTIL_LINUX
	select BR2_PACKAGE_UTIL_LINUX_LIBUUID
	select BR2_PACKAGE_UTIL_LINUX_LIBBLKID
	select BR2_PACKAGE_LIBTIRPC
	select BR2_PACKAGE_OPENSSL
	help
	  ZFS Filesystem
	  OpenZFS for Linux Implementation

	  https://github.com/zfsonlinux/zfs
```
